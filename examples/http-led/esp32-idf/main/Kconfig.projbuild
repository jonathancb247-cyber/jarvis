## examples/http-led/esp32-idf/main/Kconfig.projbuild
```kconfig
menu "JarvisOS HTTP LED Example"

config JARVIS_WIFI_SSID
    string "Wi-Fi SSID"
    default ""
    help
        Local 2.4 GHz Wi-Fi SSID used by the ESP32 example.

config JARVIS_WIFI_PASSWORD
    string "Wi-Fi Password"
    default ""
    help
        Local Wi-Fi password. Do not commit generated sdkconfig files with secrets.

endmenu
```

## examples/mqtt-led/esp32-idf/main/Kconfig.projbuild
```kconfig
menu "JarvisOS MQTT LED Example"

config JARVIS_MQTT_WIFI_SSID
    string "Wi-Fi SSID"
    default ""
    help
        Local 2.4 GHz Wi-Fi SSID used by the ESP32 MQTT example.

config JARVIS_MQTT_WIFI_PASSWORD
    string "Wi-Fi Password"
    default ""
    help
        Local Wi-Fi password. Do not commit generated sdkconfig files with secrets.

config JARVIS_MQTT_BROKER_HOST
    string "MQTT broker host"
    default ""
    help
        Local LAN address or hostname of the Mosquitto broker host. Do not commit personal addresses.

config JARVIS_MQTT_BROKER_PORT
    int "MQTT broker port"
    default 1883
    range 1 65535
    help
        MQTT broker port for local LAN validation.

config JARVIS_MQTT_CLIENT_ID
    string "MQTT client id"
    default "jarvisos-esp32-lamp-1"
    help
        MQTT client id used by the reference ESP32 node.

endmenu
```
